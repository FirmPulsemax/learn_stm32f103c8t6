/* USER CODE BEGIN Header */
/**
  ******************************************************************************
  * @file           : main.c
  * @brief          : Main program body
  ******************************************************************************
  * @attention
  *
  * Copyright (c) 2026 STMicroelectronics.
  * All rights reserved.
  *
  * This software is licensed under terms that can be found in the LICENSE file
  * in the root directory of this software component.
  * If no LICENSE file comes with this software, it is provided AS-IS.
  *
  ******************************************************************************
  */
/* USER CODE END Header */
/* Includes ------------------------------------------------------------------*/
#include "main.h"
#include "gpio.h"

/* Private includes ----------------------------------------------------------*/
/* USER CODE BEGIN Includes */
#include "oled.h"
/* USER CODE END Includes */

/* Private typedef -----------------------------------------------------------*/
/* USER CODE BEGIN PTD */

/* USER CODE END PTD */

/* Private define ------------------------------------------------------------*/
/* USER CODE BEGIN PD */

/* USER CODE END PD */

/* Private macro -------------------------------------------------------------*/
/* USER CODE BEGIN PM */

/* USER CODE END PM */

/* Private variables ---------------------------------------------------------*/

/* USER CODE BEGIN PV */

/* USER CODE END PV */

/* Private function prototypes -----------------------------------------------*/
void SystemClock_Config(void);
/* USER CODE BEGIN PFP */

/* USER CODE END PFP */

/* Private user code ---------------------------------------------------------*/
/* USER CODE BEGIN 0 */
// ==================== 汉字字模数据 ====================
// 月
const uint8_t HZ_Yue[] = {
0x00,0x00,0x00,0xFE,0x22,0x22,0x22,0x22,
0x22,0x22,0x22,0x22,0xFE,0x00,0x00,0x00,
0x80,0x40,0x30,0x0F,0x02,0x02,0x02,0x02,
0x02,0x02,0x42,0x82,0x7F,0x00,0x00,0x00
};

// 成
const uint8_t HZ_Cheng[] = {
0x00,0x00,0xF8,0x88,0x88,0x88,0x88,0x08,
0x08,0xFF,0x08,0x09,0x0A,0xC8,0x08,0x00,
0x80,0x60,0x1F,0x00,0x10,0x20,0x1F,0x80,
0x40,0x21,0x16,0x18,0x26,0x41,0xF8,0x00
};

// 功
const uint8_t HZ_Gong[] = {
0x08,0x08,0x08,0xF8,0x08,0x08,0x08,0x10,
0x10,0xFF,0x10,0x10,0x10,0xF0,0x00,0x00,
0x10,0x30,0x10,0x1F,0x08,0x88,0x48,0x30,
0x0E,0x01,0x40,0x80,0x40,0x3F,0x00,0x00
};

// 考
const uint8_t HZ_Kao[] = {
0x20,0x20,0x24,0x24,0x24,0x24,0xBF,0x64,
0x24,0x34,0x28,0x24,0x22,0x20,0x20,0x00,
0x10,0x08,0x04,0x02,0x01,0x0D,0x0B,0x09,
0x49,0x89,0x49,0x39,0x01,0x00,0x00,0x00
};

// 公（上岸用）
const uint8_t HZ_Gong2[] = {
0x00,0x80,0x40,0x20,0x18,0x06,0x80,0x00,
0x07,0x18,0x20,0x40,0x80,0x00,0x00,0x00,
0x01,0x00,0x20,0x70,0x28,0x26,0x21,0x20,
0x20,0x24,0x38,0x60,0x00,0x01,0x01,0x00
};

// 上
const uint8_t HZ_Shang[] = {
0x00,0x00,0x00,0x00,0x00,0x00,0xFF,0x40,
0x40,0x40,0x40,0x40,0x40,0x00,0x00,0x00,
0x40,0x40,0x40,0x40,0x40,0x40,0x7F,0x40,
0x40,0x40,0x40,0x40,0x40,0x40,0x40,0x00
};

// 岸
const uint8_t HZ_An[] = {
0x00,0x00,0xEE,0x28,0xA8,0xA8,0xA8,0xAF,
0xA8,0xA8,0xA8,0xA8,0xAE,0x20,0x00,0x00,
0x40,0x30,0x0F,0x04,0x04,0x04,0x04,0x04,
0xFF,0x04,0x04,0x04,0x04,0x04,0x04,0x00
};

// 祝
const uint8_t HZ_Zhu[] = {
0x08,0x08,0x89,0xEE,0x98,0x00,0x7E,0x42,
0xC2,0x42,0x42,0xC2,0x42,0x7E,0x00,0x00,
0x02,0x01,0x00,0xFF,0x80,0x43,0x20,0x18,
0x07,0x00,0x00,0x3F,0x40,0x40,0x78,0x00
};

// 同
const uint8_t HZ_Tong[] = {
0x00,0x00,0xFE,0x02,0x12,0x92,0x92,0x92,
0x92,0x92,0x92,0x12,0x02,0xFE,0x00,0x00,
0x00,0x00,0xFF,0x00,0x00,0x1F,0x08,0x08,
0x08,0x08,0x1F,0x40,0x80,0x7F,0x00,0x00
};

// 学
const uint8_t HZ_Xue[] = {
0x40,0x30,0x11,0x96,0x90,0x90,0x91,0x96,
0x90,0x90,0x98,0x14,0x13,0x50,0x30,0x00,
0x04,0x04,0x04,0x04,0x04,0x44,0x84,0x7E,
0x06,0x05,0x04,0x04,0x04,0x04,0x04,0x00
};

// 新
const uint8_t HZ_Xin[] = {
0x40,0x44,0x54,0x65,0xC6,0x64,0x54,0x44,
0x00,0xFC,0x44,0x44,0xC4,0x42,0x40,0x00,
0x20,0x12,0x4A,0x82,0x7F,0x02,0x0A,0x92,
0x60,0x1F,0x00,0x00,0xFF,0x00,0x00,0x00
};

// 撒
const uint8_t HZ_Sa[] = {
0x10,0x10,0xFF,0x10,0x90,0xA4,0xBF,0xA4,
0xBF,0xA4,0x40,0xB8,0x17,0xF0,0x10,0x00,
0x42,0x82,0x7F,0x01,0x00,0xFF,0x0A,0x0A,
0x8A,0xFF,0x40,0x27,0x18,0x67,0x80,0x00
};

// 花
const uint8_t HZ_Hua[] = {
0x04,0x04,0x04,0x84,0x6F,0x04,0x04,0x04,
0xE4,0x04,0x8F,0x44,0x24,0x04,0x04,0x00,
0x04,0x02,0x01,0xFF,0x00,0x10,0x08,0x04,
0x3F,0x41,0x40,0x40,0x40,0x40,0x78,0x00
};

// 呀
const uint8_t HZ_Ya[] = {
0x00,0xFC,0x04,0x04,0xFC,0x00,0xC2,0xBA,
0x82,0x82,0x82,0xFE,0x82,0x82,0x80,0x00,
0x00,0x0F,0x04,0x04,0x0F,0x20,0x10,0x08,
0x04,0x42,0x81,0x7F,0x00,0x00,0x00,0x00
};

// 昱
const uint8_t HZ_Yu[] = {
0x00,0x00,0x00,0x7F,0x49,0x49,0xC9,0x49,
0x49,0x49,0x49,0x7F,0x00,0x00,0x00,0x00,
0x80,0x84,0x84,0x94,0xA4,0xC4,0x84,0x87,
0x84,0xC4,0xA4,0x94,0x84,0x84,0x80,0x00
};

// 枚
const uint8_t HZ_Mei[] = {
0x10,0x10,0xD0,0xFF,0x90,0x10,0x40,0x20,
0xD8,0x17,0x10,0x10,0xF0,0x10,0x10,0x00,
0x04,0x03,0x00,0xFF,0x00,0x03,0x80,0x40,
0x21,0x16,0x08,0x16,0x21,0x40,0x80,0x00
};

// 研
const uint8_t HZ_Yan[] = {
0x04,0x84,0xE4,0x5C,0x44,0xC4,0x80,0x82,
0xFE,0x82,0x82,0x82,0xFE,0x82,0x80,0x00,
0x02,0x01,0x7F,0x10,0x10,0x3F,0x80,0x60,
0x1F,0x00,0x00,0x00,0xFF,0x00,0x00,0x00
};
/* USER CODE END 0 */

/**
  * @brief  The application entry point.
  * @retval int
  */
int main(void)
{

  /* USER CODE BEGIN 1 */

  /* USER CODE END 1 */

  /* MCU Configuration--------------------------------------------------------*/

  /* Reset of all peripherals, Initializes the Flash interface and the Systick. */
  HAL_Init();

  /* USER CODE BEGIN Init */

  /* USER CODE END Init */

  /* Configure the system clock */
  SystemClock_Config();

  /* USER CODE BEGIN SysInit */

  /* USER CODE END SysInit */

  /* Initialize all configured peripherals */
  MX_GPIO_Init();
  /* USER CODE BEGIN 2 */
  OLED_Init();
  OLED_Clear();
  
  // 第一行：祝新月同学
  OLED_ShowHZ16x16(1, 3, HZ_Zhu);
  OLED_ShowHZ16x16(1, 4, HZ_Yu);
  OLED_ShowHZ16x16(1, 5, HZ_Mei);
  OLED_ShowHZ16x16(1, 6, HZ_Tong);
  OLED_ShowHZ16x16(1, 7, HZ_Xue);

  // 第二行：考公成功上岸
  OLED_ShowHZ16x16(2, 2, HZ_Kao);
  OLED_ShowHZ16x16(2, 3, HZ_Yan);
  OLED_ShowHZ16x16(2, 4, HZ_Cheng);
  OLED_ShowHZ16x16(2, 5, HZ_Gong);
  OLED_ShowHZ16x16(2, 6, HZ_Shang);
  OLED_ShowHZ16x16(2, 7, HZ_An);
  OLED_ShowHZ16x16(2, 8, HZ_Ya);

// 第四行：撒花
  OLED_ShowHZ16x16(4, 3, HZ_Sa);
  OLED_ShowHZ16x16(4, 6, HZ_Hua);
  /* USER CODE END 2 */

  /* Infinite loop */
  /* USER CODE BEGIN WHILE */
  while (1)
  {
    HAL_GPIO_WritePin(GPIOB, GPIO_PIN_14, GPIO_PIN_RESET);//红灯亮
    //蓝绿灯灭
    HAL_GPIO_WritePin(GPIOB, GPIO_PIN_15, GPIO_PIN_SET);
    HAL_GPIO_WritePin(GPIOA, GPIO_PIN_8, GPIO_PIN_SET);
    HAL_GPIO_WritePin(GPIOB, GPIO_PIN_12, GPIO_PIN_SET);
    //延时0.5s
    HAL_Delay(500);
    
    HAL_GPIO_WritePin(GPIOB, GPIO_PIN_15, GPIO_PIN_RESET);//绿灯亮
    //红蓝灯灭
    HAL_GPIO_WritePin(GPIOB, GPIO_PIN_14, GPIO_PIN_SET);
    HAL_GPIO_WritePin(GPIOA, GPIO_PIN_8, GPIO_PIN_SET);
    
    HAL_Delay(500);

    HAL_GPIO_WritePin(GPIOA, GPIO_PIN_8, GPIO_PIN_RESET);//蓝灯亮
    //红绿灯灭
    HAL_GPIO_WritePin(GPIOB, GPIO_PIN_14, GPIO_PIN_SET);
    HAL_GPIO_WritePin(GPIOB, GPIO_PIN_15, GPIO_PIN_SET);
    HAL_GPIO_WritePin(GPIOB, GPIO_PIN_12, GPIO_PIN_RESET);

    HAL_Delay(500);
    /* USER CODE END WHILE */

    /* USER CODE BEGIN 3 */
  }
  /* USER CODE END 3 */
}

/**
  * @brief System Clock Configuration
  * @retval None
  */
void SystemClock_Config(void)
{
  RCC_OscInitTypeDef RCC_OscInitStruct = {0};
  RCC_ClkInitTypeDef RCC_ClkInitStruct = {0};

  /** Initializes the RCC Oscillators according to the specified parameters
  * in the RCC_OscInitTypeDef structure.
  */
  RCC_OscInitStruct.OscillatorType = RCC_OSCILLATORTYPE_HSE;
  RCC_OscInitStruct.HSEState = RCC_HSE_ON;
  RCC_OscInitStruct.HSEPredivValue = RCC_HSE_PREDIV_DIV1;
  RCC_OscInitStruct.HSIState = RCC_HSI_ON;
  RCC_OscInitStruct.PLL.PLLState = RCC_PLL_ON;
  RCC_OscInitStruct.PLL.PLLSource = RCC_PLLSOURCE_HSE;
  RCC_OscInitStruct.PLL.PLLMUL = RCC_PLL_MUL9;
  if (HAL_RCC_OscConfig(&RCC_OscInitStruct) != HAL_OK)
  {
    Error_Handler();
  }

  /** Initializes the CPU, AHB and APB buses clocks
  */
  RCC_ClkInitStruct.ClockType = RCC_CLOCKTYPE_HCLK|RCC_CLOCKTYPE_SYSCLK
                              |RCC_CLOCKTYPE_PCLK1|RCC_CLOCKTYPE_PCLK2;
  RCC_ClkInitStruct.SYSCLKSource = RCC_SYSCLKSOURCE_PLLCLK;
  RCC_ClkInitStruct.AHBCLKDivider = RCC_SYSCLK_DIV1;
  RCC_ClkInitStruct.APB1CLKDivider = RCC_HCLK_DIV2;
  RCC_ClkInitStruct.APB2CLKDivider = RCC_HCLK_DIV1;

  if (HAL_RCC_ClockConfig(&RCC_ClkInitStruct, FLASH_LATENCY_2) != HAL_OK)
  {
    Error_Handler();
  }
}

/* USER CODE BEGIN 4 */

/* USER CODE END 4 */

/**
  * @brief  This function is executed in case of error occurrence.
  * @retval None
  */
void Error_Handler(void)
{
  /* USER CODE BEGIN Error_Handler_Debug */
  /* User can add his own implementation to report the HAL error return state */
  __disable_irq();
  while (1)
  {
  }
  /* USER CODE END Error_Handler_Debug */
}
#ifdef USE_FULL_ASSERT
/**
  * @brief  Reports the name of the source file and the source line number
  *         where the assert_param error has occurred.
  * @param  file: pointer to the source file name
  * @param  line: assert_param error line source number
  * @retval None
  */
void assert_failed(uint8_t *file, uint32_t line)
{
  /* USER CODE BEGIN 6 */
  /* User can add his own implementation to report the file name and line number,
     ex: printf("Wrong parameters value: file %s on line %d\r\n", file, line) */
  /* USER CODE END 6 */
}
#endif /* USE_FULL_ASSERT */
